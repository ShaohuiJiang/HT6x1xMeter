/*******************************************************************************
* @file      : main.c
* @author    : Jiangshaohui
* @version   : V1.0.0
* @date      : Sun Jan 28 2018
* @brief     : 
********************************************************************************
* @attention :
*
*
*/
/*头文件----------------------------------------------------------------------*/
///添加头文件
#include <stdio.h>
#include "ht6xxx_lib.h"
#include "MCUConfig.h"
#include "TaskSystem.h"

/*宏定义----------------------------------------------------------------------*/
///添加宏定义




/*内部变量声明----------------------------------------------------------------*/
///添加内部变量




/*声明内部函数----------------------------------------------------------------*/
///声明只在本文件使用的函数






/*定义内部函数----------------------------------------------------------------*/
///定义只能在本文件使用的函数





/*定义全局函数----------------------------------------------------------------*/
///定义可用于外部文件的函数
/** 
 * @brief  Main主函数
 * @note   架构是复位后，首选MCU初始化，然后进入大的死循环，进行外部电源判断，
 *         如果有电，就进入上电状态，如果没电就进入掉电状态，
 *         上电状态：先进行上电状态初始化，然后进入死循环，循环中执行各种任务，并且时不时判断外部电压
 *                  如果判断到掉电，保存重要参数后，就用break退回到大的死循环，重新再次进行电源判断；
 *         下电状态：先进行掉电状态初始化，然后进入死循环，执行完任务，并且判断外部电源，如果判断到外部有电，
 *                  就用软复位重新执行main函数，或者用break退回到大的死循环，重新再次进行电源判断，
 *                  如果判断到外部仍然还是没有电，降低频率，然后进入hold模式，等待外部中断和秒中断唤醒。
 * @retval 
 */
int main(void)
{
    /*最开始时关闭总中断*/
    Disable_Int();
    /* 低功耗状态初始化 */
    Init_MCU_BatteryState();

    while (1)       //大的死循环，除非复位，不然程序永远在里面运行
    {
        /* 判断外部电源，根据电源状态，进入相应循环 ，注意如果采用该模式，低功耗模式采用hold模式*/
        if(TRUE==Check_PowerOn(100))        //判断外部电源状态是有电状态
        {
            /*外部电源供电状态初始化*/
            Init_MCU_ExternalPowerState();
            /* 初始化系统任务 */
            Init_TaskSystem();
            /* 进入上电状态循环前，打开全局中断 */
            Enable_Int();

            while(1)                        //上电状态循环
            {
                Run_TaskSystem();           //系统任务，主要是判断外部电源，假如外部电源为0，就结束各种任务
                //添加各种任务1
                Feed_WDT();                 //清看门狗
                //~~~~~

                Run_TaskSystem();           //系统任务，主要是判断外部电源，假如外部电源为0，就结束各种任务
                //添加各种任务x
                Feed_WDT();                 //清看门狗
                //~~~~~
            }
        }
        else                                //判断到外部电源状态是无电状态
        {
            /* 低功耗状态初始化 */
            Init_MCU_BatteryState();
            /* 进入下电状态循环前，打开全局中断 */
            Enable_Int();
        
            while(1)                       //下电状态循环
            {
                //添加各种任务1
                //清看门狗
                //判断外部电源
                //~~~~~

                //添加各种任务x
                //清看门狗
                //判断外部电源
                //~~~~~

                
                /* 关闭各种不必要的模块时钟，降低CPU时钟频率到32k */
                Init_MCU_HoldState();
                /* 进入hold模式，等待被唤醒 */
                Goto_Hold();

            }
        }
    }
}

/*end-------------------------------------------------------------------------*/



